#include <Arduino.h>
#include <Wire.h>
#include <Adafruit_GFX.h>
#include <Adafruit_SSD1306.h>
#include <Adafruit_Sensor.h>
#include <Adafruit_BME680.h>

// bitmaps from image2cpp

const unsigned char epd_bitmap_1_healthy [] PROGMEM = {
	0x00, 0x00, 0x00, 0x00, 0x00, 0x00, 0x00, 0x00, 0x00, 0x00, 0x00, 0x00, 0x00, 0x00, 0x00, 0x00, 
	0x00, 0x00, 0x00, 0x00, 0x00, 0x00, 0x00, 0x00, 0x00, 0x00, 0x00, 0x00, 0x00, 0x00, 0x00, 0x00, 
	0x00, 0x00, 0x00, 0x00, 0x00, 0x00, 0x00, 0x00, 0x00, 0x00, 0x00, 0x00, 0x00, 0x00, 0x00, 0x00, 
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	0x00, 0x00, 0x00, 0x00, 0x00, 0x00, 0x00, 0x00, 0x00, 0x00, 0x00, 0x00, 0x00, 0x00, 0x00, 0x00
};
const unsigned char epd_bitmap_2_uncomfy [] PROGMEM = {
	0x00, 0x00, 0x00, 0x00, 0x00, 0x00, 0x00, 0x00, 0x00, 0x00, 0x00, 0x00, 0x00, 0x00, 0x00, 0x00, 
	0x00, 0x00, 0x00, 0x00, 0x00, 0x00, 0x00, 0x00, 0x00, 0x00, 0x00, 0x00, 0x00, 0x00, 0x00, 0x00, 
	0x00, 0x00, 0x00, 0x00, 0x00, 0x00, 0x00, 0x00, 0x00, 0x00, 0x00, 0x00, 0x00, 0x00, 0x00, 0x00, 
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	0x00, 0x00, 0x00, 0x00, 0x00, 0x00, 0x00, 0x00, 0x00, 0x00, 0x00, 0x00, 0x00, 0x00, 0x00, 0x00
};
const unsigned char epd_bitmap_3_nothealthy [] PROGMEM = {
	0x00, 0x00, 0x00, 0x00, 0x00, 0x00, 0x00, 0x00, 0x00, 0x00, 0x00, 0x00, 0x00, 0x00, 0x00, 0x00, 
	0x00, 0x00, 0x00, 0x00, 0x00, 0x00, 0x00, 0x00, 0x00, 0x00, 0x00, 0x00, 0x00, 0x00, 0x00, 0x00, 
	0x00, 0x00, 0x00, 0x00, 0x00, 0x00, 0x00, 0x00, 0x00, 0x00, 0x00, 0x00, 0x00, 0x00, 0x00, 0x00, 
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	0x00, 0x00, 0x00, 0x00, 0x00, 0x00, 0x00, 0x00, 0x00, 0x00, 0x00, 0x00, 0x00, 0x00, 0x00, 0x00
};
const unsigned char epd_bitmap_4_dying [] PROGMEM = {
	0x00, 0x00, 0x00, 0x00, 0x00, 0x00, 0x00, 0x00, 0x00, 0x00, 0x00, 0x00, 0x00, 0x00, 0x00, 0x00, 
	0x00, 0x00, 0x00, 0x00, 0x00, 0x00, 0x00, 0x00, 0x00, 0x00, 0x00, 0x00, 0x00, 0x00, 0x00, 0x00, 
	0x00, 0x00, 0x00, 0x00, 0x00, 0x00, 0x00, 0x00, 0x00, 0x00, 0x00, 0x00, 0x00, 0x00, 0x00, 0x00, 
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	0x00, 0x00, 0x00, 0x00, 0x00, 0x00, 0x00, 0x00, 0x00, 0x00, 0x00, 0x00, 0x00, 0x00, 0x00, 0x00
};
const unsigned char epd_bitmap_5_dead [] PROGMEM = {
	0x00, 0x00, 0x00, 0x00, 0x00, 0x00, 0x00, 0x00, 0x00, 0x00, 0x00, 0x00, 0x00, 0x00, 0x00, 0x00, 
	0x00, 0x00, 0x00, 0x00, 0x00, 0x00, 0x00, 0x00, 0x00, 0x00, 0x00, 0x00, 0x00, 0x00, 0x00, 0x00, 
	0x00, 0x00, 0x00, 0x00, 0x00, 0x00, 0x00, 0x00, 0x00, 0x00, 0x00, 0x00, 0x00, 0x00, 0x00, 0x00, 
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	0x00, 0x00, 0x00, 0x00, 0x00, 0x00, 0x00, 0x00, 0x00, 0x00, 0x00, 0x00, 0x00, 0x00, 0x00, 0x00
};

Adafruit_BME680 bme; // called class, its now an object

// constants

const int SCREEN_WIDTH = 128;
const int SCREEN_HEIGHT = 64;
const int X = 0;
const int Y = 0;

// variables
int avg_temp, temp_offset;
int avg_gas, gas_offset;
int screenstate = 0;
bool calibrated = 0;

// initializes display or whatever
Adafruit_SSD1306 display(SCREEN_WIDTH, SCREEN_HEIGHT, &Wire, -1);

// functions for menus

void menu(void) {
  display.clearDisplay();
  display.setCursor(X,Y);
  display.setTextSize(2);
  display.println("Canary");
  display.setTextSize(1);
  display.println("Canary mode ^");
  display.println("Info dwn arw");
  display.println("Calibrate *");
  display.display();
  // Should display the title and the options
  /* Canary
     Canary mode ^
     Calibrate 
  */
}

void calibrate(void) {
  int gasres[10];
  avg_gas = 0;
  display.clearDisplay();
  display.setCursor(X,Y);
  display.println("Calibrating!");
  display.display();
  display.setTextSize(1);
  for (int i = 0; i <= 9; i++) {
	bme.performReading();  
	String msg = "There is " + String(i) + " done";
    gasres[i] = bme.gas_resistance / 1000;
    delay(10);
	display.clearDisplay();
	display.setCursor(X,Y);
	display.println(msg);
	display.display();
  }

  for (int i = 0; i <= 9; i++) {
    avg_gas += gasres[i];
	Serial.println(avg_gas);
    if (i == 9) {
      avg_gas /= 10;
	  Serial.println(avg_gas);
    }
  }
  delay(1000);
  display.clearDisplay();
  display.println("Calibration complete!");
  display.display();
  delay(2000);
  menu();
  // shoud display how many checks are complete, then send back to menu
}

void canary() {
  bme.performReading();
  int current_gas_res = bme.gas_resistance / 1000;
  int gaschange = avg_gas - current_gas_res;
  display.clearDisplay();
  display.setCursor(X,Y);
  display.setTextSize(1);
  if (gaschange < 20) {
	display.drawBitmap(0, 0, epd_bitmap_1_healthy, 128, 64, WHITE);
	// serials were to debug
	Serial.println("Good");
  }
  if (20 <= gaschange && gaschange < 25) {
	display.drawBitmap(0, 0, epd_bitmap_2_uncomfy, 128, 64, WHITE);
	Serial.println("Not good");
	ledcWriteTone(0, 1000);
  	delay(100);
  }
  if (25 <= gaschange && gaschange < 30) {
	display.drawBitmap(0, 0, epd_bitmap_3_nothealthy, 128, 64, WHITE);
	Serial.println("Bad");
	ledcWriteTone(0, 1000);
  	delay(200);
  }
  if (30 <= gaschange && gaschange < 35) {
	display.drawBitmap(0, 0, epd_bitmap_4_dying, 128, 64, WHITE);
	Serial.println("Superbad");
	ledcWriteTone(0, 1000);
  	delay(300);
  }
  if (35 <= gaschange) {
	display.drawBitmap(0, 0, epd_bitmap_5_dead, 128, 64, WHITE);
	Serial.println("Skull");
	ledcWriteTone(0, 1000);
  	delay(600);
  }
  // OLED display didnt have enough room for full words like resistance, so we shortened it
  display.setCursor(65, 0);
  display.println("Gas resist");
  display.setCursor(65, 16);
  display.println(current_gas_res);
  display.setCursor(65, 32);
  display.println("Gas change:");
  display.setCursor(65, 48);
  display.println(gaschange);
  display.display();
  ledcWriteTone(0, 0);
  delay(1000);

  // should display the bird + info
}

void info() {
  display.clearDisplay();
  display.setCursor(X,Y);
  display.setTextSize(1);
  display.println("Cnry: Tell if unsafe environment");
  display.println("Info: info page");
  display.println("Cali: Adjust measurements to standard");
  display.println("Stand in ideal conditions");
  display.display();

  // should display info screen with text above
}

// main functions

void setup() {
  // General sec
  Serial.begin(115200);
  // doesnt begin it if no serials not same
  while (!Serial);

  pinMode(13, INPUT);
  pinMode(14, INPUT);
  pinMode(27, INPUT);
  pinMode(26, INPUT);

  // Buzzer sec
  ledcSetup(0, 2000, 8);
  ledcAttachPin(25, 0);

  // BME sec
  Serial.println("BME test");

  // doesnt work without a BME680
  if (!bme.begin()) {
    Serial.println("could not find BME sensor");
    while (1);
  }
  
  Serial.println("Test complete");
  bme.setTemperatureOversampling(BME680_OS_8X);
  bme.setHumidityOversampling(BME680_OS_2X);
  bme.setPressureOversampling(BME680_OS_4X);
  bme.setIIRFilterSize(BME680_FILTER_SIZE_3);
  bme.setGasHeater(320, 150);


  // OLED sec
  
  if(!display.begin(SSD1306_SWITCHCAPVCC, 0x3C)) { 
    Serial.println(F("SSD1306 allocation failed"));
    while (1); 
  }
  display.clearDisplay();
  display.setCursor(X,Y);
  display.setTextSize(1);
  display.setTextColor(SSD1306_WHITE);
  menu();

}

void loop() {
  if (digitalRead(26) == 0 || screenstate == 1) {
    info();
    screenstate = 1;
  }
  if ((digitalRead(27) == 0 || screenstate == 2)) {
    if (calibrated == 1) {
		canary();
		screenstate = 2;
	}
	else {
		display.clearDisplay();
		display.setCursor(X,Y);
		display.println("Calibrate first!");
		display.display();
		delay(1000);
		menu();
	}
  }
  if (digitalRead(14) == 0 || screenstate == 3) {
    calibrate();
	screenstate = 0;
	calibrated = 1;

  }
// menu, doesnt have its own button, but on this it has
  if (digitalRead(13) == 0 || screenstate == 0) {
	menu();
  }
}